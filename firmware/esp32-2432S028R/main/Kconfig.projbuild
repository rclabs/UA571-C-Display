## firmware/esp32-2432S028R/main/Kconfig.projbuild
```kconfig
menu "Aliens sentry"

    config ALIENS_AUDIO_ENABLED
        bool "Synthesized critical warning on the CYD speaker output"
        depends on IDF_TARGET_ESP32
        default y
        select DAC_DMA_AUTO_16BIT_ALIGN
        help
            Use the standard ESP32-2432S028R onboard amplifier fed by GPIO26
            (DAC channel 1). GPIO25 remains available for touch. Disable for
            boards with different wiring or when no audible warning is wanted.
            Uses the ESP32 DAC continuous-mode/I2S0 DMA peripheral.

    config ALIENS_AUDIO_VOLUME
        int "Warning volume (%)"
        depends on ALIENS_AUDIO_ENABLED
        range 0 100
        default 15
        help
            Start low: speaker and amplifier gain vary between board versions.
            Zero is silent.

    config ALIENS_START_IN_CRITICAL
        bool "Start the demo at the critical threshold (sound/display test)"
        default n
        help
            Start at 10 rounds (the configured code default) instead of 20.
            Useful for testing the warning immediately at startup.
            The normal demo resumes after the counter reaches zero.

endmenu
```

## firmware/esp32-2432S028R/sdkconfig.defaults
```kconfig
CONFIG_IDF_TARGET="esp32"
CONFIG_ESPTOOLPY_FLASHSIZE_4MB=y
CONFIG_PARTITION_TABLE_CUSTOM=y
CONFIG_PARTITION_TABLE_CUSTOM_FILENAME="partitions.csv"

CONFIG_LV_COLOR_DEPTH_16=y
CONFIG_LV_COLOR_DEPTH=16
CONFIG_LV_DRAW_SW_COMPLEX=y
CONFIG_LV_USE_BAR=y
CONFIG_LV_USE_FLEX=y
CONFIG_LV_USE_LABEL=y
CONFIG_LV_USE_LINE=y
CONFIG_LV_FONT_MONTSERRAT_12=y
CONFIG_LV_FONT_DEFAULT_MONTSERRAT_12=y
CONFIG_LV_THEME_DEFAULT_DARK=y

CONFIG_XPT2046_INTERRUPT_MODE=y
```
